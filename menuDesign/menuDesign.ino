// Code adapted and written by Ryan Scott 23/11/24

#include "U8g2lib.h"

U8G2_SSD1306_128X64_NONAME_F_HW_I2C u8g2(U8G2_R0); // [full framebuffer, size = 1024 bytes]

// 'MyPC', 16x16px
const unsigned char bitmap_my_PC [] PROGMEM = {
  0x00, 0x00, 0xf8, 0x1f, 0x08, 0x10, 0x28, 0x15, 0xc8, 0x11, 0xa8, 0x13, 0x88, 0x10, 0x08, 0x14, 
  0x08, 0x11, 0xc8, 0x11, 0x88, 0x13, 0x88, 0x10, 0x28, 0x14, 0x08, 0x10, 0xf8, 0x1f, 0x00, 0x00
};
// 'NeonSign', 16x16px
const unsigned char bitmap_neon_sign [] PROGMEM = {
  0x08, 0x00, 0x80, 0x08, 0x00, 0x40, 0x06, 0x00, 0x49, 0x00, 0x01, 0x00, 0x26, 0x73, 0x88, 0x94, 
  0xa9, 0x94, 0x26, 0x93, 0x00, 0x04, 0x92, 0x04, 0x00, 0x23, 0x00, 0x00, 0x10, 0x02, 0x00, 0x00
};
// 'Lamp', 16x16px
const unsigned char bitmap_lamp [] PROGMEM = {
  0x00, 0x02, 0x02, 0x80, 0xf0, 0x0f, 0xf0, 0x0f, 0xfa, 0x1f, 0xf8, 0x5f, 0xf8, 0x1f, 0xfc, 0x3f, 
  0xfc, 0x3f, 0x80, 0x01, 0x90, 0x11, 0x82, 0x41, 0x80, 0x01, 0xf0, 0x0f, 0x00, 0x00, 0x00, 0x00
};
// 'DeskLamp', 16x16px
const unsigned char bitmap_desk_lamp [] PROGMEM = {
  0x00, 0x00, 0x00, 0x00, 0xe0, 0x00, 0xa0, 0x01, 0x70, 0x03, 0x70, 0x06, 0xf8, 0x0c, 0x00, 0x18, 
  0x90, 0x30, 0x00, 0x30, 0xa0, 0x18, 0x04, 0x0c, 0x00, 0x06, 0xf0, 0x1f, 0x00, 0x00, 0x00, 0x00
};
// 'SaltLampIcon', 16x16px
const unsigned char bitmap_salt_lamp [] PROGMEM = {
  0x00, 0x00, 0x10, 0x10, 0x00, 0x03, 0x80, 0x03, 0xc0, 0x07, 0xe4, 0x27, 0xe0, 0x07, 0xf0, 0x0f, 
  0xf0, 0x0f, 0xf8, 0x1f, 0xf8, 0x1f, 0xf0, 0x0f, 0xe0, 0x07, 0xe0, 0x07, 0x00, 0x00, 0x00, 0x00
};

// Array of all bitmaps for convenience. (Total bytes used to store images in PROGMEM = 240)
const int bitmap_lights_LEN = 5;
const unsigned char* bitmap_light_icons[bitmap_lights_LEN] = {
  bitmap_my_PC,
  bitmap_lamp,
  bitmap_desk_lamp,
  bitmap_salt_lamp,
  bitmap_neon_sign
};


// 'scrollbar_background', 8x64px
const unsigned char bitmap_scrollbar_background [] PROGMEM = {
  0x00, 0x40, 0x00, 0x40, 0x00, 0x40, 0x00, 0x40, 0x00, 0x40, 0x00, 0x40, 
  0x00, 0x40, 0x00, 0x40, 0x00, 0x40, 0x00, 0x40, 0x00, 0x40, 0x00, 0x40, 
  0x00, 0x40, 0x00, 0x40, 0x00, 0x40, 0x00, 0x40, 0x00, 0x40, 0x00, 0x40, 
  0x00, 0x40, 0x00, 0x40, 0x00, 0x40, 0x00, 0x40, 0x00, 0x40, 0x00, 0x40, 
  0x00, 0x40, 0x00, 0x40, 0x00, 0x40, 0x00, 0x40, 0x00, 0x40, 0x00, 0x40, 
  0x00, 0x40, 0x00, 0x00, };

  // 'item_sel_outline', 128x21px
const unsigned char bitmap_item_sel_outline [] PROGMEM = {
  0xF8, 0xFF, 0xFF, 0xFF, 0xFF, 0xFF, 0xFF, 0xFF, 0xFF, 0xFF, 0xFF, 0xFF, 
  0xFF, 0xFF, 0xFF, 0x03, 0x04, 0x00, 0x00, 0x00, 0x00, 0x00, 0x00, 0x00, 
  0x00, 0x00, 0x00, 0x00, 0x00, 0x00, 0x00, 0x04, 0x02, 0x00, 0x00, 0x00, 
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  0xFF, 0xFF, 0xFF, 0xFF, 0xFF, 0xFF, 0xFF, 0xFF, 0xFF, 0xFF, 0xFF, 0x03, 
  };

// 'SelectionScreenScenes', 128x64px
const unsigned char bitmap_selection_screen_scenes [] PROGMEM = {
  0x00, 0x00, 0x00, 0x00, 0x00, 0x00, 0x00, 0x00, 0x00, 0x00, 0x00, 0x00, 0x00, 0x00, 0x00, 0x00, 
  0x00, 0x00, 0x00, 0x00, 0x00, 0x00, 0x00, 0x00, 0x00, 0x00, 0x00, 0x00, 0x00, 0x00, 0x00, 0x00, 
  0x00, 0x00, 0x00, 0x00, 0x00, 0x00, 0x00, 0x00, 0x00, 0x00, 0x00, 0x00, 0x00, 0x00, 0x00, 0x00, 
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  0x00, 0x00, 0x00, 0x00, 0x00, 0x00, 0x00, 0x00, 0x00, 0x00, 0x00, 0x00, 0x00, 0x00, 0x00, 0x00
};
// 'SelectionScreenLights', 128x64px
const unsigned char bitmap_selection_screen_lights [] PROGMEM = {
  0x00, 0x00, 0x00, 0x00, 0x00, 0x00, 0x00, 0x00, 0x00, 0x00, 0x00, 0x00, 0x00, 0x00, 0x00, 0x00, 
  0x00, 0x00, 0x00, 0x00, 0x00, 0x00, 0x00, 0x00, 0x00, 0x00, 0x00, 0x00, 0x00, 0x00, 0x00, 0x00, 
  0x00, 0x00, 0x00, 0x00, 0x00, 0x00, 0x00, 0x00, 0x00, 0x00, 0x00, 0x00, 0x00, 0x00, 0x00, 0x00, 
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  0x00, 0x00, 0x00, 0x00, 0x00, 0x00, 0x00, 0x00, 0x00, 0x00, 0x00, 0x00, 0x00, 0x00, 0x00, 0x00
};

// Array of all bitmaps for convenience. (Total bytes used to store images in PROGMEM = 2080)
const int bitmap_selection_array_LEN = 2;
const unsigned char* bitmap_selection_array[2] = {
  bitmap_selection_screen_lights,
  bitmap_selection_screen_scenes
};


// 'next_sel_outline', 128x21px
const unsigned char bitmap_next_sel_outline [] PROGMEM = {
  0x00, 0x00, 0x00, 0x00, 0x00, 0x00, 0x00, 0x00, 0x00, 0x00, 0x00, 0x00, 0x00, 0x00, 0x00, 0x00, 
  0x00, 0x00, 0x00, 0x00, 0x00, 0x00, 0x00, 0x00, 0x00, 0x00, 0x00, 0x00, 0x00, 0x00, 0x00, 0x00, 
  0xc0, 0xff, 0xff, 0xff, 0xff, 0xff, 0xff, 0xff, 0xff, 0xff, 0xff, 0xff, 0xff, 0xff, 0x7f, 0x00, 
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  0x00, 0x00, 0x00, 0x00, 0x00, 0x00, 0x00, 0x00, 0x00, 0x00, 0x00, 0x00, 0x00, 0x00, 0x00, 0x00
};

// 'previous_sel_outline', 128x21px
const unsigned char bitmap_previous_sel_outline [] PROGMEM = {
  0x00, 0x00, 0x00, 0x00, 0x00, 0x00, 0x00, 0x00, 0x00, 0x00, 0x00, 0x00, 0x00, 0x00, 0x00, 0x00, 
  0x00, 0x00, 0x00, 0x00, 0x00, 0x00, 0x00, 0x00, 0x00, 0x00, 0x00, 0x00, 0x00, 0x00, 0x00, 0x00, 
  0x00, 0xfe, 0xff, 0xff, 0xff, 0xff, 0xff, 0xff, 0xff, 0xff, 0xff, 0xff, 0xff, 0xff, 0x0f, 0x00, 
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  0x00, 0x00, 0x00, 0x00, 0x00, 0x00, 0x00, 0x00, 0x00, 0x00, 0x00, 0x00, 0x00, 0x00, 0x00, 0x00
};



// ------------------------------- end of bitmaps ------------------------------- 


const int NUM_ITEMS_LIGHTS = 5; // number of items in the list
const int NUM_ITEMS_SCENES = 3;
const int MAX_ITEM_LENGTH = 20; // maximum characters for the item name
int menu_selections [2] = {
  NUM_ITEMS_LIGHTS,
  NUM_ITEMS_SCENES
};


char menu_items [2] [NUM_ITEMS_LIGHTS] [MAX_ITEM_LENGTH] = {{  // array with the light items and scene items in 3D array
  { "My PC" }, 
  { "Lamp" }, 
  { "Desk Lamp" }, 
  { "Salt Lamp" }, 
  { "Neon Sign" }
},
{
  { "Bed Time" },
  { "Purple" },
  { "Full" }
}
};


#define BUTTON_UP_PIN 18 // pin for UP button 
#define BUTTON_SELECT_PIN 33 // pin for SELECT button
#define BUTTON_DOWN_PIN 19 // pin for DOWN button
#define BUTTON_BACK_PIN 5 // pin for BACK button

int button_up_clicked = 0; // only perform action when button is clicked, and wait until another press
int button_select_clicked = 0; // same as above
int button_down_clicked = 0; // same as above
int button_back_clicked = 0; // same as above

int item_selected = 0; // which item in the menu is selected
int item_sel_previous; // previous item - used in the menu screen to draw the item before the selected one
int item_sel_next; // next item - used in the menu screen to draw next item after the selected one

int current_screen = 1;   // 0 = selection, 1 = menu, 2 = selected

int selection_option = 0;  // 0 = lights, 1 = scenes

void setup() {
  u8g2.setDrawColor(1);  // set the color to white
  u8g2.begin();
  u8g2.setBitmapMode(1);
  Serial.begin(9600);

  // define pins for buttons
  // INPUT_PULLUP means the button is HIGH when not pressed, and LOW when pressed
  // since it´s connected between some pin and GND
  pinMode(BUTTON_UP_PIN, INPUT_PULLUP); // up button
  pinMode(BUTTON_SELECT_PIN, INPUT_PULLUP); // select button
  pinMode(BUTTON_DOWN_PIN, INPUT_PULLUP); // down button
  pinMode(BUTTON_BACK_PIN, INPUT_PULLUP); // back button
}


void loop() {
    if (current_screen == 1) { // MENU SCREEN
      // up and down buttons only work for the menu screen
      if ((digitalRead(BUTTON_UP_PIN) == LOW) && (button_up_clicked == 0)) { // up button clicked - jump to previous menu item
        item_selected = item_selected - 1; // select previous item
        button_up_clicked = 1; // set button to clicked to only perform the action once
        if (item_selected < 0) { // if first item was selected, jump to last item
          item_selected = menu_selections[selection_option]-1;
        }
      }
      else if ((digitalRead(BUTTON_DOWN_PIN) == LOW) && (button_down_clicked == 0)) { // down button clicked - jump to next menu item
        item_selected = item_selected + 1; // select next item
        button_down_clicked = 1; // set button to clicked to only perform the action once
        if (item_selected >= menu_selections[selection_option]) { // last item was selected, jump to first menu item
          item_selected = 0;
          }
      } 

      if ((digitalRead(BUTTON_UP_PIN) == HIGH) && (button_up_clicked == 1)) { // unclick 
        button_up_clicked = 0;
      }
      if ((digitalRead(BUTTON_DOWN_PIN) == HIGH) && (button_down_clicked == 1)) { // unclick
        button_down_clicked = 0;
      }
  }

  if (current_screen == 0) {
    if ((digitalRead(BUTTON_UP_PIN) == LOW) && (button_up_clicked == 0)) { // up button clicked - jump to previous menu item
        selection_option = 0; // highlight lights option
        button_up_clicked = 1; // set button to clicked to only perform the action once
      }
      else if ((digitalRead(BUTTON_DOWN_PIN) == LOW) && (button_down_clicked == 0)) { // down button clicked - jump to next menu item
        selection_option = 1; // highlight scenes option
        button_down_clicked = 1; // set button to clicked to only perform the action once
      } 

      if ((digitalRead(BUTTON_UP_PIN) == HIGH) && (button_up_clicked == 1)) { // unclick 
        button_up_clicked = 0;
      }
      if ((digitalRead(BUTTON_DOWN_PIN) == HIGH) && (button_down_clicked == 1)) { // unclick
        button_down_clicked = 0;
      }
  }

  if ((digitalRead(BUTTON_SELECT_PIN) == LOW) && (button_select_clicked == 0)) { // select button clicked, jump between screens
     button_select_clicked = 1; // set button to clicked to only perform the action once
     if (current_screen == 0) {current_screen = 1; item_selected = 0;} // selection screen --> menu items screen
     else if (current_screen == 1) {current_screen = 2; Serial.println(menu_items[selection_option][item_selected]);} // menu items screen --> selected item screen
     else {current_screen = 1;} // selected item screen --> menu items screen
  }
  if ((digitalRead(BUTTON_SELECT_PIN) == HIGH) && (button_select_clicked == 1)) { // unclick 
    button_select_clicked = 0;
  }

  if ((digitalRead(BUTTON_BACK_PIN) == LOW) && (button_back_clicked == 0)) { // back button clicked, jump between screens
    button_back_clicked = 1; // set button to clicked to only perform the action once
    if (current_screen == 1) {current_screen = 0;} // menu items screen --> selection screen
    else if (current_screen == 2) {current_screen = 1;} // selected item screen -->  menu items screen
  }
  if ((digitalRead(BUTTON_BACK_PIN) == HIGH) && (button_back_clicked == 1)) { // unclick 
    button_back_clicked = 0;
  }

  // set correct values for the previous and next items
  item_sel_previous = item_selected - 1;
  if (item_sel_previous < 0) {item_sel_previous = menu_selections[selection_option] - 1;} // previous item would be below first = make it the last
  item_sel_next = item_selected + 1;  
  if (item_sel_next >= menu_selections[selection_option]) {item_sel_next = 0;} // next item would be after last = make it the first

  u8g2.clearBuffer();  // clear buffer for storing display content in RAM
  
  if (current_screen == 1) { // MENU SCREEN
    

    // selected item background
    u8g2.drawXBMP(0, 22, 128, 21, bitmap_item_sel_outline);
    u8g2.drawXBMP(0, 44, 128, 21, bitmap_next_sel_outline);
    u8g2.drawXBMP(0,  1, 128, 21, bitmap_previous_sel_outline);

    // draw previous item as small label
    u8g2.setFont(u8g_font_5x8);
    u8g2.drawStr(floor((128 - u8g2.getUTF8Width(menu_items[selection_option][item_sel_previous]))/2), 15 - 1 , menu_items[selection_option][item_sel_previous]); 
    //u8g2.drawXBMP( 4, 2, 16, 16, bitmap_light_icons[item_sel_previous]);          

    // draw selected item as icon + label in bold font
    u8g2.setFont(u8g_font_7x14B);    
    u8g2.drawStr(floor((128 - u8g2.getUTF8Width(menu_items[selection_option][item_selected]))/2), 15+20+2, menu_items[selection_option][item_selected]);   
    u8g2.drawXBMP( 4, 24, 16, 16, bitmap_light_icons[item_selected]);     

    // draw next item as small label
    u8g2.setFont(u8g_font_5x8);     
    u8g2.drawStr(floor((128 - u8g2.getUTF8Width(menu_items[selection_option][item_sel_next]))/2), 15+20+20+2, menu_items[selection_option][item_sel_next]);   
    //u8g2.drawXBMP( 4, 46, 16, 16, bitmap_light_icons[item_sel_next]);  

    // draw scrollbar background
    u8g2.drawXBMP(128-8, 0, 8, 64, bitmap_scrollbar_background);

    // draw scrollbar handle
    u8g2.drawBox(125, 64/menu_selections[selection_option] * item_selected, 3, 64/menu_selections[selection_option]);             
  } 
  
  else if (current_screen == 2) { // SELECTED ITEM SCREEN
      //u8g2.drawXBMP( 0, 0, 128, 64, bitmap_qr_codes[item_selected]); // draw qr code screenshot
      u8g2.drawStr(floor((128 - u8g2.getUTF8Width(menu_items[selection_option][item_selected]))/2), 15+20+2, menu_items[selection_option][item_selected]);   // need to work out
  }   

  else if (current_screen == 0) { // SELECTION SCREEN SCREEN
      u8g2.drawXBMP( 0, 0, 128, 64, bitmap_selection_array[selection_option]); // draw selection screen
      
  }   
  u8g2.sendBuffer(); // send buffer from RAM to display controller
  
}
